## CMakeLists.txt
```
# Copyright (c) 2025 liangyq <liangyongqincn@gmail.com>
# SPDX-License-Identifier: Apache-2.0

cmake_minimum_required(VERSION 3.20.0)
find_package(Zephyr REQUIRED HINTS $ENV{ZEPHYR_BASE})
project(mco)

target_sources(app PRIVATE src/main.c)
```

## prj.conf
```kconfig
# Copyright (c) 2025 liangyq <liangyongqincn@gmail.com>
# SPDX-License-Identifier: Apache-2.0

# gpio
CONFIG_GPIO=y

# serial
CONFIG_SERIAL=y

# console
CONFIG_CONSOLE=y
CONFIG_UART_CONSOLE=y
```

## boards/challenger.overlay
```dts
/*
 * Copyright (c) 2025 liangyq <liangyongqincn@gmail.com>
 *
 * SPDX-License-Identifier: Apache-2.0
 */

/* MCO Maximum: 100 MHz(the maximum I/O speed)*/

/* MCO1 */
#define MCO1_SEL_HSI    0
#define MCO1_SEL_LSE    1
#define MCO1_SEL_HSE    2
#define MCO1_SEL_PLL    3

#define MCO1_PRE_DIV_1  0
#define MCO1_PRE_DIV_2  4
#define MCO1_PRE_DIV_3  5
#define MCO1_PRE_DIV_4  6
#define MCO1_PRE_DIV_5  7

/* MCO2 */
#define MCO2_SEL_SYSCLK 0
#define MCO2_SEL_PLLI2S 1
#define MCO2_SEL_HSE    2
#define MCO2_SEL_PLL    3

#define MCO2_PRE_DIV_1  0
#define MCO2_PRE_DIV_2  4
#define MCO2_PRE_DIV_3  5
#define MCO2_PRE_DIV_4  6
#define MCO2_PRE_DIV_5  7

&clk_hse {
    status = "okay";
};

&mco1 {
	clocks = <&rcc STM32_SRC_HSE MCO1_SEL(MCO1_SEL_HSE)>;
	prescaler = <MCO1_PRE(MCO1_PRE_DIV_2)>;
	pinctrl-0 = <&rcc_mco_1_pa8>;
	pinctrl-names = "default";
	status = "okay";
};

&mco2 {
	clocks = <&rcc STM32_SRC_HSE MCO2_SEL(MCO2_SEL_HSE)>;
	prescaler = <MCO2_PRE(MCO2_PRE_DIV_2)>;
	pinctrl-0 = <&rcc_mco_2_pc9>;
	pinctrl-names = "default";
	status = "okay";
};
```

## src/main.c
```c
/*
 * Copyright (c) 2025 liangyq <liangyongqincn@gmail.com>
 *
 * SPDX-License-Identifier: Apache-2.0
 */

#include <zephyr/kernel.h>
#include <zephyr/drivers/pinctrl.h>

int main(void)
{
    printk("clock mco demo");
#if DT_NODE_HAS_STATUS_OKAY(DT_NODELABEL(mco1))
	const struct device *dev1;

	dev1 = DEVICE_DT_GET(DT_NODELABEL(mco1));
	if (device_is_ready(dev1)) {
		printk("MCO1 device successfully configured\n");
	} else {
		printk("MCO1 device not ready\n");
		return -1;
	}
#endif /* mco1 */

#if DT_NODE_HAS_STATUS_OKAY(DT_NODELABEL(mco2))
	const struct device *dev2;

	dev2 = DEVICE_DT_GET(DT_NODELABEL(mco2));
	if (device_is_ready(dev2)) {
		printk("MCO2 device successfully configured\n");
	} else {
		printk("MCO2 device not ready\n");
		return -1;
	}
#endif /* mco2 */

	printk("\nDisplayed the status of all MCO devices - end of example.\n");
	return 0;
}
```
