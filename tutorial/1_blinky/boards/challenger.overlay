/*
 * Copyright (c) 2025 liangyq <liangyongqincn@gmail.com>
 *
 * SPDX-License-Identifier: Apache-2.0
 */

/ {
	leds {
    	compatible = "gpio-leds";
    	led_red: led_0 {
        	gpios = <&gpioh 10 GPIO_ACTIVE_LOW>;
        	label = "led red";
        };
    };

    aliases {
        led0= &led_red; /* now you support the blinky sample! */
    };
};
